## Config.in
```kconfig
source "$BR2_EXTERNAL_SYNTHESIZER_OS_PATH/package/python-pygame-261/Config.in"
source "$BR2_EXTERNAL_SYNTHESIZER_OS_PATH/package/python-pyopengl/Config.in"
source "$BR2_EXTERNAL_SYNTHESIZER_OS_PATH/package/python-synthesizer/Config.in"
source "$BR2_EXTERNAL_SYNTHESIZER_OS_PATH/package/brcmfmac-firmware/Config.in"
```

## package/python-synthesizer/Config.in
```kconfig
config BR2_PACKAGE_PYTHON_SYNTHESIZER
	bool "python-synthesizer"
	depends on BR2_PACKAGE_PYTHON3
	depends on BR2_INSTALL_LIBSTDCPP
	select BR2_PACKAGE_PYTHON_PYGAME_261
	select BR2_PACKAGE_PYTHON_NUMPY
	select BR2_PACKAGE_SYNTHESIZER_AUDIO_ENGINE
	help
	  Additive synthesizer using Pygame, Numpy, and a low-latency
	  C++ ALSA audio engine (libsynthengine.so).
```

## package/synthesizer-audio-engine/Config.in
```kconfig
config BR2_PACKAGE_SYNTHESIZER_AUDIO_ENGINE
	bool "synthesizer-audio-engine"
	depends on BR2_INSTALL_LIBSTDCPP
	depends on BR2_PACKAGE_ALSA_LIB
	help
	  Low-latency C++17 ALSA audio engine for the additive synthesizer.
	  Exposes a C ABI shared library (libsynthengine.so) that the Python
	  synthesizer package loads via ctypes for near-zero-overhead audio
	  generation and playback.
```
